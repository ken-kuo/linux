## drivers/md/dm-pcache/Kconfig
```kconfig
config DM_PCACHE
	tristate "Persistent cache for Block Device (Experimental)"
	depends on BLK_DEV_DM
	help
	  PCACHE provides a mechanism to use a fast block device — either
	  persistent memory exposed via DAX (e.g. CXL persistent memory,
	  /dev/pmemN) or a plain NVMe SSD — as a high-performance cache
	  layer in front of a slower backing block device.

	  The cache medium is auto-detected at construction:
	    - DAX-capable cache device  -> byte-addressable PMEM backend
	                                   (memcpy_flushcache + pmem_wmb)
	    - non-DAX block device       -> NVMe backend (bio-based I/O,
	                                   DRAM-staged metadata, FLUSH-boundary
	                                   data drain + device cache flush)

	  Note: This feature is experimental and should be tested thoroughly
	  before use in production environments.

	  If unsure, say 'N'.
```
